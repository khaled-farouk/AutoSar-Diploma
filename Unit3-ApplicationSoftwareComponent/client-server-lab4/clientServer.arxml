AUTOSAR XML (schema 4-2-2)
package /CS_sum
  client server interface CS_IF
    operation CS_IF_SUM
      arg IN1: type=uint16, direction=IN
      arg IN2: type=uint16, direction=IN
      arg OUT: type=uint32, direction=OUT
  application sw component type SWC_SERVER
    provide port Pport1_CS: client-server-annotation=operation=CS_IF_SUM
  application sw component type SWC_client
    require port Rport1_CS: client-server-annotation=CS_IF_SUM

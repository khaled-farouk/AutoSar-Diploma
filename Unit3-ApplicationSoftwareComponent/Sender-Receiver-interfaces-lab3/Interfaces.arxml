AUTOSAR XML (schema 00046)
package /SR_Interface_Lab
  sender receiver interface SRI_Lidar
    data Lidar_ObjectDistance: type=uint16, init-value=7
    data Lidar_ObjetID: type=uint16
    data Lidar_ObjectAngle: type=uint32
  sensor actuator sw component type LidarSensor_SWC
    provide port SR_PP_LidarData: provided-interface=SRI_Lidar
  application sw component type LidarAlgo_SWC
    require port SR_RP_LidarData: required-interface=SRI_Lidar
